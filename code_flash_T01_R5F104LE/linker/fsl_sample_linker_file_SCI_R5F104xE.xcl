//=================================================================================================
// Project      = Flash self-programming library, MF3 single voltage flash
// Module       = fsl_sample_linker_file_SCI_R5F104xE.xcl
// Device:      = RL78
// Version      = V2.11
//=================================================================================================
//                                  COPYRIGHT
//=================================================================================================
// Copyright(c) 2010-2011 by Renesas Electronics Europe GmbH, a company of the Renesas Electronics
// Corporation. All rights reserved.
//=================================================================================================
// Purpose:
//              linker sample file
//
//=================================================================================================
//
// Warranty Disclaimer
//
// Because the Product(s) is licensed free of charge, there is no warranty of any kind whatsoever
// and expressly disclaimed and excluded by Renesas, either expressed or implied, including but
// not limited to those for non-infringement of intellectual property, merchantability and/or
// fitness for the particular purpose.
// Renesas shall not have any obligation to maintain, service or provide bug fixes for the
// supplied Product(s) and/or the Application.
//
// Each User is solely responsible for determining the appropriateness of using the Product(s)
// and assumes all risks associated with its exercise of rights under this Agreement, including,
// but not limited to the risks and costs of program errors, compliance with applicable laws,
// damage to or loss of data, programs or equipment, and unavailability or interruption of
// operations.
//
// Limitation of Liability
//
// In no event shall Renesas be liable to the User for any incidental, consequential, indirect,
// or punitive damage (including but not limited to lost profits) regardless of whether such
// liability is based on breach of contract, tort, strict liability, breach of warranties,
// failure of essential purpose or otherwise and even if advised of the possibility of such
// damages. Renesas shall not be liable for any services or products provided by third party
// vendors, developers or consultants identified or referred to the User by Renesas in
// connection with the Product(s) and/or the Application.
//
//=================================================================================================
//
// Environment  = IAR environment for RL78
//
//=================================================================================================
//      Target specific definitions - do not edit
//=================================================================================================
-cRL78                                  // RL78 CPU
-D_CODE_PAGE_SIZE=0x10000               // Page size 64K
-Z(CODE)INTVEC=00000-0007F              // Interrupt vector segment. Constant location
-Z(CODE)CLTVEC=00080-000BF              // CALLT vector segment. Constant location
-Z(CODE)OPTBYTE=000C0-000C3             // OPTION BYTES segment. Constant location
-Z(CODE)SECUID=000C4-000CD              // SECURITY_ID segment. Constant location
-D_RAM_END=0xFFEDF                      // top of ram memory - 5.5KB total
-D_ROM_END=0xFFFF                       // Total flash on chip - 64K
-D_WRKSEG_START=0xFFE20                 // work segment
-D_SADDR_START=0xFFE20                  // short address area

-D_BOOT_CLUSTER_0_PROGRAM_START=0xD8    // 0xCE-0xD7 reserved for debug monitor
-D_BOOT_CLUSTER_0_PROGRAM_END=0xFFF     // with OCD user code starts from 0xD8
-D_BOOT_CLUSTER_1_PROGRAM_START=0x10D8  // 0x10CE-0x10D7 reserved for debug monitor
-D_BOOT_CLUSTER_1_PROGRAM_END=0x1FFF    // with OCD user code starts from 0x10D8

-D_NEAR_SEGMENT_END=0xFFFF

-D_FSL_RESERVED_RAM_START=0xFE900       // need to reserve this RAM space for the FSL when used
-D_FSL_RESERVED_RAM_END=0xFED09         // defining the symbols, will be referenced in the linker map file
-D_FSL_RAM_ISR_END=0xFFE19              // not allowed to allocate ISR routine over this ram limit (0xFFE20)

-D_USER_RAM_END=0xFFE19                 // ram limit, data buffer cannot be placed above this range
-D_USER_ROM_END=0xFBFF                  // end of the application usable flash

-D_OCD_MONITOR_RESERVED_START=0xFC00       // need to leave last 1K block for OCD monitor
-D_OCD_MONITOR_RESERVED_END=_ROM_END
                    

//=================================================================================================
//      User configuration
//=================================================================================================

//-------------------------------------------------------------------------
//      Remove comments below and modify values if building from command line
//-------------------------------------------------------------------------
//-D_CSTACK_SIZE=80                                     // stack size
//-D_NEAR_HEAP_SIZE=400                                 // heap size
//-D_FAR_HEAP_SIZE=200                                  // far heap size

// mirror area selection:
// 0 -> Mirror 1st 64K 0x0:0xFFFF
// 2 -> Copy to Ram
//-D_NEAR_CONST_LOCATION=0              // only 0 available because of flash size
//-D_NEAR_CONST_LOCATION_START=0x2000   // target mirror area (max 50.25 K)
//-D_NEAR_CONST_LOCATION_END=0xE8FF


//-------------------------------------------------------------------------

-D_PROGRAM_AREA_START=0x2000            // where the rest of the user program is located
-D_PROGRAM_AREA_END=0xCFFF              // up to the desired code flash size, rest is self programmed

-D_FAR_SEGMENT_START=0x2000             // not really applicable because of flash size
-D_FAR_SEGMENT_END=_PROGRAM_AREA_END    

-D_FSL_BASE_ADDRESS=0x4000      // where the FSL library code is located

// for this example linker script reserve the top 64K flash block for self programming
// to reference the symbol APPLICATION_FLASH within the program, IAR extensions are needed 
-D_SELFPROG_FLASH_START=0xD000
-D_SELFPROG_FLASH_END=_USER_ROM_END
-Z(CONST)APPLICATION_FLASH=_SELFPROG_FLASH_START-_SELFPROG_FLASH_END

//-------------------------------------------------------------------------
//      FAR data segments initializer. !!! IMPORTANT !!!
//      The FAR_I and FAR_ID segments MUST start at the same offset 
//      from a 64 Kb boundary
//-------------------------------------------------------------------------
-D_FAR_DATA_LOCATION_START=0xFED0A  // place at beginning of user ram
-D_FAR_DATA_LOCATION_END=0xFEDAF

-D_FAR_INITIALIZER_START=0xED0A     // make sure offset within page is the same of _FAR_DATA_LOCATION_START
-D_FAR_INITIALIZER_END=0xEDAF       // make sure offset within page is the same of _FAR_DATA_LOCATION_END

-D_USER_RAM_START=0xFEDB0


// define the segments for ram based interrupt routine (in case used)
// FSL_INT_RAM_CODE is the execution region for load region FSL_INT_ROM_CODE
-QFSL_INT_RAM_CODE=FSL_INT_ROM_CODE

// this defines the ram execution region
-Z(DATA)FSL_INT_RAM_CODE=[_USER_RAM_START-_FSL_RAM_ISR_END] 

// this is where the same routine is located in flash before copy to ram
-Z(CODE)FSL_INT_ROM_CODE=[_PROGRAM_AREA_START-_NEAR_SEGMENT_END]/_CODE_PAGE_SIZE 



//-------------------------------------------------------------------------
//      Remove comments below and modify values if building from command line
//-------------------------------------------------------------------------

//-e_PrintfTiny=_Printf     // Used by DLIB                    
//-e_PrintfSmall=_Printf    // select the format functions used by printf/scanf
//-e_PrintfLarge=_Printf    // (default full)
//-e_ScanfSmall=_Scanf
//-e_ScanfLarge=_Scanf

//-e__write_buffered=__write    // Uncomment to get buffered terminal output (default none)

//-e_small_write=_formatted_write   // Used by CLIB
//-e_medium_write=_formatted_write  // select select the format functions used by printf/scanf
//-e_medium_read=_formatted_read    // (default full)

//-Fdebug   // output file format


//-------------------------------------------------------------------------

//=================================================================================================
// The target settings below are either fixed or determined according to user setup section
// Do not edit unless you know what you are doing !
//=================================================================================================

//-------------------------------------------------------------------------
//      Startup, Runtime-library, Near, Interrupts, CALLT functions code segment
//-------------------------------------------------------------------------
-Z(CODE)RCODE=_BOOT_CLUSTER_0_PROGRAM_START-_BOOT_CLUSTER_0_PROGRAM_END
-Z(CODE)CODE=_PROGRAM_AREA_START-_NEAR_SEGMENT_END
-Z(CODE)XCODE=[_FAR_SEGMENT_START-_PROGRAM_AREA_END]/_CODE_PAGE_SIZE
-Z(CONST)DIFUNCT=[_PROGRAM_AREA_START-_NEAR_SEGMENT_END]/_CODE_PAGE_SIZE // C++ constructors

//-------------------------------------------------------------------------
//      Near initializer segments. Placed by default within the first 64K
//-------------------------------------------------------------------------
-Z(CONST)NEAR_ID=[_PROGRAM_AREA_START-_NEAR_SEGMENT_END]/_CODE_PAGE_SIZE
-Z(CONST)SADDR_ID=[_PROGRAM_AREA_START-_NEAR_SEGMENT_END]/_CODE_PAGE_SIZE
-Z(FARCONST)FAR_ID=[_FAR_INITIALIZER_START-_FAR_INITIALIZER_END]/_CODE_PAGE_SIZE 

//-------------------------------------------------------------------------
//      Constant segments
//-------------------------------------------------------------------------
// symbols defined by the IAR IDE , refer to the mirror area
-Z(CONST)NEAR_CONST=[_NEAR_CONST_LOCATION_START-_NEAR_CONST_LOCATION_END]/_CODE_PAGE_SIZE

-Z(CONST)FAR_CONST=[_FAR_SEGMENT_START-_FAR_SEGMENT_END]/_CODE_PAGE_SIZE
-Z(CONST)SWITCH=_PROGRAM_AREA_START-_NEAR_SEGMENT_END

//-------------------------------------------------------------------------
//      FSL must be included in the same 64K segment !
//-------------------------------------------------------------------------
// FSL size is declared max 0x546 (1350 bytes)
-D_FSL_MAX_SIZE=0x546  

-Z(CODE)FSL_FCD=[_FSL_BASE_ADDRESS:+_FSL_MAX_SIZE]/_CODE_PAGE_SIZE
-Z(CODE)FSL_FECD=[_FSL_BASE_ADDRESS:+_FSL_MAX_SIZE]/_CODE_PAGE_SIZE
-Z(CODE)FSL_BCD=[_FSL_BASE_ADDRESS:+_FSL_MAX_SIZE]/_CODE_PAGE_SIZE
-Z(CODE)FSL_BECD=[_FSL_BASE_ADDRESS:+_FSL_MAX_SIZE]/_CODE_PAGE_SIZE
-Z(CODE)FSL_RCD=[_FSL_BASE_ADDRESS:+_FSL_MAX_SIZE]/_CODE_PAGE_SIZE

//-------------------------------------------------------------------------
//      Ram segments
//-------------------------------------------------------------------------
-Z(DATA)WRKSEG=_WRKSEG_START-_RAM_END                  // working segment

-Z(DATA)SADDR_I,SADDR_Z,SADDR_N=_SADDR_START-_RAM_END  // short address 

-Z(DATA)NEAR_I,NEAR_Z,NEAR_N=_USER_RAM_START-_USER_RAM_END  // near data

-Z(FARDATA)FAR_I,FAR_N,FAR_Z=[_FAR_DATA_LOCATION_START-_FAR_DATA_LOCATION_END]/_CODE_PAGE_SIZE

-Z(DATA)CSTACK+_CSTACK_SIZE#_SADDR_START // Place from top of ram, just below saddr area

-Z(DATA)NEAR_HEAP+_NEAR_HEAP_SIZE=[_USER_RAM_START-_USER_RAM_END]

-Z(DATA)FAR_HEAP+_FAR_HEAP_SIZE=[_USER_RAM_START-_USER_RAM_END]



//-------------------------------------------------------------------------
//      End of File
//-------------------------------------------------------------------------