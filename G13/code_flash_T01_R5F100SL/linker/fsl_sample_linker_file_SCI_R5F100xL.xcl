//=================================================================================================
// Project      = Flash self-programming library, MF3 single voltage flash
// Module       = fsl_sample_linker_file_SCI_R5F100xL.xcl
// Device:      = RL78
// Version      = V1.0
//=================================================================================================
//                                  COPYRIGHT
//=================================================================================================
// Copyright(c) 2010-2011 by Renesas Electronics Europe GmbH, a company of the Renesas Electronics
// Corporation. All rights reserved.
//=================================================================================================
// Purpose:
//              linker sample file
//
//=================================================================================================
//
// Warranty Disclaimer
//
// Because the Product(s) is licensed free of charge, there is no warranty of any kind whatsoever
// and expressly disclaimed and excluded by Renesas, either expressed or implied, including but
// not limited to those for non-infringement of intellectual property, merchantability and/or
// fitness for the particular purpose.
// Renesas shall not have any obligation to maintain, service or provide bug fixes for the
// supplied Product(s) and/or the Application.
//
// Each User is solely responsible for determining the appropriateness of using the Product(s)
// and assumes all risks associated with its exercise of rights under this Agreement, including,
// but not limited to the risks and costs of program errors, compliance with applicable laws,
// damage to or loss of data, programs or equipment, and unavailability or interruption of
// operations.
//
// Limitation of Liability
//
// In no event shall Renesas be liable to the User for any incidental, consequential, indirect,
// or punitive damage (including but not limited to lost profits) regardless of whether such
// liability is based on breach of contract, tort, strict liability, breach of warranties,
// failure of essential purpose or otherwise and even if advised of the possibility of such
// damages. Renesas shall not be liable for any services or products provided by third party
// vendors, developers or consultants identified or referred to the User by Renesas in
// connection with the Product(s) and/or the Application.
//
//=================================================================================================
//
// Environment  = IAR environment for RL78
//
//=================================================================================================
//      Target specific definitions - do not edit
//=================================================================================================
-cRL78                                  // RL78 CPU
-D_CODE_PAGE_SIZE=0x10000               // Page size 64K
-Z(CODE)INTVEC=00000-0007F              // Interrupt vector segment. Constant location
-Z(CODE)CLTVEC=00080-000BF              // CALLT vector segment. Constant location
-Z(CODE)OPTBYTE=000C0-000C3             // OPTION BYTES segment. Constant location
-Z(CODE)SECUID=000C4-000CD              // SECURITY_ID segment. Constant location
-D_RAM_END=0xFFEDF                      // top of user ram memory - 32KB total
-D_ROM_END=0x7FFFF                      // Total flash on chip - 512K
-D_WRKSEG_START=0xFFE20                 // work segment
-D_SADDR_START=0xFFE20                  // short address area

-D_BOOT_CLUSTER_0_PROGRAM_START=0xD8    // 0xCE-0xD7 reserved for debug monitor
-D_BOOT_CLUSTER_0_PROGRAM_END=0xFFF     // with OCD user code starts from 0xD8
-D_BOOT_CLUSTER_1_PROGRAM_START=0x10D8  // 0x10CE-0x10D7 reserved for debug monitor
-D_BOOT_CLUSTER_1_PROGRAM_END=0x1FFF    // with OCD user code starts from 0x10D8

-D_PROGRAM_AREA_START=0x2000            // application code flash block
-D_FAR_SEGMENT_START=0x10000            // far segments start after 1st 64K block

-D_USER_ROM_END=0x7FBFF                 // end of the application usable flash

-D_OCD_MONITOR_RESERVED_START=0x7FC00       // need to leave last 1K block for OCD monitor
-D_OCD_MONITOR_RESERVED_END=_ROM_END

-D_FSL_RESERVED_RAM_START=0xF7F00       // need to reserve this RAM space for the FSL when used
-D_FSL_RESERVED_RAM_END=0xF8309         // defining the symbols, will be referenced in the linker map file

-D_USER_RAM_START=0xF830A
-D_USER_RAM_END=0xFFE1F                 // ram limit, data buffer cannot be placed above this range
-D_FSL_RAM_ISR_END=0xFFE1F              // not allowed to allocate ISR routine over this ram limit (0xFFE20)
//=================================================================================================
//      User configuration
//=================================================================================================

//-------------------------------------------------------------------------
//      Remove comments below and modify values if building from command line
//-------------------------------------------------------------------------
//-D_CSTACK_SIZE=80                                     // stack size
//-D_NEAR_HEAP_SIZE=400                                 // heap size
//-D_FAR_HEAP_SIZE=4000                                 // far heap size

/* mirror area selection:
* 0 -> Mirror 1st 64K 0x0:0xFFFF 
* 1 -> Mirror 2nd 64K 0x10000:0x1FFFF
* 2 -> located in ram 
*/
//-D_NEAR_CONST_LOCATION=0
//-D_NEAR_CONST_LOCATION_START=0x3000   // target mirror area (max 19.75 K)
//-D_NEAR_CONST_LOCATION_END=0x7EFF

//-------------------------------------------------------------------------


-D_FSL_BASE_ADDRESS=0x4000      // where the FSL library code is located
-D_PROGRAM_AREA_END=0x6FFFF     // application code end
-D_NEAR_SEGMENT_END=0xFFFF
-D_FAR_SEGMENT_END=0x6FFFF



// for this example linker script reserve the top 64K flash block for self programming
// to reference the symbol APPLICATION_FLASH within the program, IAR extensions are needed 
-D_SELFPROG_FLASH_START=0x70000
-D_SELFPROG_FLASH_END=_USER_ROM_END
-Z(CONST)APPLICATION_FLASH=_SELFPROG_FLASH_START-_SELFPROG_FLASH_END

//-------------------------------------------------------------------------
//      FAR data segments initializer. !!! IMPORTANT !!!
//      The FAR_I and FAR_ID segments MUST start at the same offset 
//      from a 64 Kb boundary
//-------------------------------------------------------------------------
// do not define this, avoid using far data definitions!
//-D_FAR_DATA_START=0xF830A  // place at beginning of user ram
//-D_FAR_DATA_END=0xFBFFF
//-D_FAR_INIT_BOTTOM=0x8309
//-D_FAR_INIT_START=0x830A     // make sure offset within page is the same of _FAR_DATA_LOCATION_START
//-D_FAR_INIT_END=0xBFFF       // make sure offset within page is the same of _FAR_DATA_LOCATION_END
//-D_FAR_INIT_TOP=0xC000       // double check with mirror area for overlaps
//-D_FAR_ID_START=_FAR_INIT_START         
//-D_FAR_ID_END=_FAR_INIT_END
//-Z(FARCONST)FAR_ID=[_FAR_ID_START-_FAR_ID_END]/_CODE_PAGE_SIZE 


// define the segments for ram based interrupt routine (in case used)
// FSL_INT_RAM_CODE is the execution region for load region FSL_INT_ROM_CODE
-QFSL_INT_RAM_CODE=FSL_INT_ROM_CODE

// this defines the ram execution region for the FSL interrupt routine
-Z(DATA)FSL_INT_RAM_CODE=[_USER_RAM_START-_FSL_RAM_ISR_END] 

// this is where the same routine is located in flash before copy to ram
-Z(CODE)FSL_INT_ROM_CODE=[_PROGRAM_AREA_START-_NEAR_SEGMENT_END]/_CODE_PAGE_SIZE 

// IAR Library and startup code
-D_RCODE_START=_BOOT_CLUSTER_0_PROGRAM_START
-D_RCODE_END=_BOOT_CLUSTER_0_PROGRAM_END

-D_CODE_START=_PROGRAM_AREA_START
-D_CODE_END=_NEAR_SEGMENT_END

-D_XCODE_START=_FAR_SEGMENT_START
-D_XCODE_END=_FAR_SEGMENT_END

-D_CPP_INIT_START=_PROGRAM_AREA_START
-D_CPP_INIT_END=_NEAR_SEGMENT_END       // placed in the first 64K

-D_NEAR_ID_START=_PROGRAM_AREA_START
-D_NEAR_ID_END=_NEAR_SEGMENT_END        // placed in the first 64K

-D_SADDR_ID_START=_PROGRAM_AREA_START
-D_SADDR_ID_END=_NEAR_SEGMENT_END       // placed in the first 64K

-D_SWITCH_START=_PROGRAM_AREA_START
-D_SWITCH_END=_NEAR_SEGMENT_END

-D_FDL_START=_PROGRAM_AREA_START
-D_FDL_END=_PROGRAM_AREA_END


//-------------------------------------------------------------------------
//      Remove comments below and modify values if building from command line
//-------------------------------------------------------------------------

//-e_PrintfTiny=_Printf     // Used by DLIB                    
//-e_PrintfSmall=_Printf    // select the format functions used by printf/scanf
//-e_PrintfLarge=_Printf    // (default full)
//-e_ScanfSmall=_Scanf
//-e_ScanfLarge=_Scanf

//-e__write_buffered=__write    // Uncomment to get buffered terminal output (default none)

//-e_small_write=_formatted_write   // Used by CLIB
//-e_medium_write=_formatted_write  // select select the format functions used by printf/scanf
//-e_medium_read=_formatted_read    // (default full)

//-Fdebug   // output file format

//-------------------------------------------------------------------------



//=================================================================================================
// The target settings below are either fixed or determined according to user setup section
// Do not edit unless you know what you are doing !
//=================================================================================================

//-------------------------------------------------------------------------
//      Startup, Runtime-library, Near, Interrupts, CALLT functions code segment
//-------------------------------------------------------------------------
-Z(CODE)RCODE=[_RCODE_START-_RCODE_END]/_CODE_PAGE_SIZE
-Z(CODE)CODE=[_CODE_START-_CODE_END]/_CODE_PAGE_SIZE

-Z(CODE)XCODE=[_XCODE_START-_XCODE_END]/_CODE_PAGE_SIZE

// C++ constructors
-Z(CONST)DIFUNCT=[_CPP_INIT_START-_CPP_INIT_END]/_CODE_PAGE_SIZE 


//-------------------------------------------------------------------------
//      Near initializer segments. Placed by default within the first 64K
//-------------------------------------------------------------------------
-Z(CONST)NEAR_ID=[_NEAR_ID_START-_NEAR_ID_END]/_CODE_PAGE_SIZE
-Z(CONST)SADDR_ID=[_SADDR_ID_START-_SADDR_ID_END]/_CODE_PAGE_SIZE


//-------------------------------------------------------------------------
//      Constant segments
//-------------------------------------------------------------------------
// symbols defined by the IAR IDE , refer to the mirror area
-Z(CONST)NEAR_CONST=[_NEAR_CONST_LOCATION_START-_NEAR_CONST_LOCATION_END]/_CODE_PAGE_SIZE

-D_FAR_CONST_START=_FAR_SEGMENT_START
-D_FAR_CONST_END=_FAR_SEGMENT_END

-Z(CONST)FAR_CONST=[_FAR_CONST_START-_FAR_CONST_END]/_CODE_PAGE_SIZE

-Z(CONST)SWITCH=[_SWITCH_START-_SWITCH_END]/_CODE_PAGE_SIZE

//-------------------------------------------------------------------------
//      FSL must be included in the same 64K segment !
//-------------------------------------------------------------------------
// FSL size is declared max 0x546 (1350 bytes)
-D_FSL_MAX_SIZE=0x546  

-Z(CODE)FSL_FCD=[_FSL_BASE_ADDRESS:+_FSL_MAX_SIZE]/_CODE_PAGE_SIZE
-Z(CODE)FSL_FECD=[_FSL_BASE_ADDRESS:+_FSL_MAX_SIZE]/_CODE_PAGE_SIZE
-Z(CODE)FSL_BCD=[_FSL_BASE_ADDRESS:+_FSL_MAX_SIZE]/_CODE_PAGE_SIZE
-Z(CODE)FSL_BECD=[_FSL_BASE_ADDRESS:+_FSL_MAX_SIZE]/_CODE_PAGE_SIZE
-Z(CODE)FSL_RCD=[_FSL_BASE_ADDRESS:+_FSL_MAX_SIZE]/_CODE_PAGE_SIZE

//-------------------------------------------------------------------------
//      Ram segments
//-------------------------------------------------------------------------
-Z(DATA)WRKSEG=_WRKSEG_START-_RAM_END                  // working segment

-Z(DATA)SADDR_I,SADDR_Z,SADDR_N=_SADDR_START-_RAM_END  // short address 

-Z(DATA)NEAR_I,NEAR_Z,NEAR_N=_USER_RAM_START-_USER_RAM_END  // near data

// FAR_Z is declared by cstartup code. Need to define this into the linker script
// to be able to build, but should not consume resource on the target
// The application should avoid using far data
-Z(FARDATA)FAR_Z=[_USER_RAM_START-_USER_RAM_END]/_CODE_PAGE_SIZE

-Z(DATA)CSTACK+_CSTACK_SIZE#_SADDR_START // Place from top of ram, STARTING just below saddr area

-Z(DATA)NEAR_HEAP+_NEAR_HEAP_SIZE=[_USER_RAM_START-_USER_RAM_END]

-Z(DATA)FAR_HEAP+_FAR_HEAP_SIZE=[_USER_RAM_START-_USER_RAM_END]



//-------------------------------------------------------------------------
//      End of File
//-------------------------------------------------------------------------